## base_external/package/ldd/Config.in
```kconfig
config BR2_PACKAGE_LDD
	bool "ldd"
	depends on BR2_LINUX_KERNEL
	help
	  adds assignment kernel modules. This package requires the Linux
	  kernel to be enabled so that out-of-tree kernel modules can be
	  built and installed.
```
